## main/Kconfig.projbuild
```kconfig
menu "Example Configuration"

config AWS_ACCESS_KEY
    string "Amazon service access key ID"
    default ""
    help
        Amazon service Access key ID

config AWS_SECRET_KEY
    string "Amazon service access secret"
    default ""
    help
        Amazon service Access secret

config AWS_DEFAULT_REGION
    string "Amazon service region"
    default "us-east-1"
    help
        Amazon service region

config DHT_GPIO
    int "DHT data pin"
    range ENV_GPIO_RANGE_MIN ENV_GPIO_OUT_RANGE_MAX
    default 9
    help
        GPIO pin number to be used for DHT11/DHT22

config DHT_TYPE
    int "DHT type"
    default 11
    help
        11 for DHT11, 22 for DHT22

config MEASUREMENT_INTERVAL_S
    int "The measurement interval in seconds"
    default 2
    help
        The measurement interval in seconds

config SITEWISE_ASSET_ID
    string "SiteWise asset ID"
    default ""
    help
        Amazon SiteWise asset ID

config SITEWISE_TEMPERATURE_PROPERTY_ID
    string "SiteWise property ID for temperature"
    default ""
    help
        Amazon SiteWise property ID for temperature

config SITEWISE_HUMIDITY_PROPERTY_ID
    string "SiteWise property ID for humidity"
    default ""
    help
        Amazon SiteWise property ID for humidity

endmenu
```
